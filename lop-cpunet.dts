/dts-v1/;

/ {
        compatible = "system-device-tree-v1,lop";
        lops {
                compatible = "system-device-tree-v1,lop";
                lop_0 {
                        compatible = "system-device-tree-v1,lop,modify";
                        modify = "/cpus-cluster@1/::/cpus/";
                };
                lop_1 {
                        compatible = "system-device-tree-v1,lop,modify";
                        modify = "/cpus-cluster@0/::";
                };
        };
};
